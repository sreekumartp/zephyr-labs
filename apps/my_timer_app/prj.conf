## CMakeLists.txt
```
cmake_minimum_required(VERSION 3.20.0)
set(BOARD native_sim)
find_package(Zephyr REQUIRED HINTS $ENV{ZEPHYR_BASE})
project(my_timer_app)
target_sources(app PRIVATE src/main.c)
```

## prj.conf
```kconfig
# Enable standard Zephyr features
CONFIG_PRINTK=y
CONFIG_MAIN_STACK_SIZE=1024
```

## src/main.c
```c
#include <zephyr/kernel.h>
#include <zephyr/sys/printk.h>

struct k_timer my_timer;

void timer_handler(struct k_timer *timer_id)
{
    printk("Timer expired\n");
}

int  main(void)
{
    k_timer_init(&my_timer, timer_handler, NULL);
    k_timer_start(&my_timer, K_MSEC(1000), K_MSEC(1000));

    while (1) {
        k_msleep(5000);
    }
 return(0);
}
```
