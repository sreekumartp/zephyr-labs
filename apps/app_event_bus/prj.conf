## CMakeLists.txt
```
cmake_minimum_required(VERSION 3.20.0)

# This line is critical and must come first.
list(APPEND ZEPHYR_EXTRA_MODULES ${CMAKE_CURRENT_SOURCE_DIR}/../../components/event_bus)

find_package(Zephyr REQUIRED HINTS $ENV{ZEPHYR_BASE})
project(event_bus_app)

# Add all application sources directly to the 'app' target.
# The 'app' target is automatically created by find_package(Zephyr).
target_sources(app PRIVATE
    src/main.c
    src/sender.c
    src/polling_receiver.c
    src/callback_receiver.c
    src/processing_thread.c
)

# The application needs access to the public headers of the component.
target_include_directories(app PRIVATE
    ../../components/event_bus/include
    src/
)

# Link the application against the library target.
target_link_libraries(app PRIVATE event_bus_lib)
```

## prj.conf
```kconfig
# Basic Zephyr Configs
CONFIG_SERIAL=y
CONFIG_UART_CONSOLE=y

# Enable Logging
CONFIG_LOG=y
CONFIG_LOG_MODE_IMMEDIATE=y
CONFIG_LOG_THREAD_ID_PREFIX=y

# Enable named threads for better logging
CONFIG_THREAD_NAME=y

# --- Kconfig Choice Selection ---
# Select ONE of the two options.
# To test the polling mechanism, comment out the CALLBACK line
# and uncomment the POLLING line.
# CONFIG_EVENT_BUS_USE_POLLING=y
CONFIG_EVENT_BUS_USE_CALLBACK=y

# --- Required config if using CALLBACK choice ---
CONFIG_SYSTEM_WORKQUEUE_STACK_SIZE=2048
```

## src/main.c
```c
#include <zephyr/kernel.h>
#include <zephyr/logging/log.h>
#include "event_bus.h"

LOG_MODULE_REGISTER(main, CONFIG_LOG_DEFAULT_LEVEL);

int main(void)
{
    LOG_INF("--- Event Bus Test Application ---");
    LOG_INF("Initializing event bus...");

    if (event_bus_init() != 0) {
        LOG_ERR("Event bus initialization failed!");
        return 1;
    }

    LOG_INF("Event bus initialized. Test is running...");
    return 0;
}
```

## src/callback_receiver.c
```c
#include <zephyr/kernel.h>
#include <zephyr/logging/log.h>
#include "event_bus.h"

#if defined(CONFIG_EVENT_BUS_USE_CALLBACK)

LOG_MODULE_REGISTER(callback_receiver, CONFIG_LOG_DEFAULT_LEVEL);

// This is an external reference to the processing thread's message queue.
extern struct k_msgq processing_msgq;

// The callback is now lightweight and non-blocking.
static void app_event_handler(const app_event_t *event)
{
    // Don't do any work here. Just hand the event off.
    int ret = k_msgq_put(&processing_msgq, event, K_NO_WAIT);
    if (ret != 0) {
        LOG_WRN("Could not enqueue event for processing thread, queue may be full.");
    } else {
        LOG_INF("Callback receiver ENQUEUED event %d for processing thread.", event->id);
    }
}

static int register_callback(void)
{
    const event_id_t subscribed_events[] = { EVENT_DOOR_OPENED };
    LOG_INF("Registering lightweight hand-off callback for EVENT_APP_MESSAGE_SENT.");
    return event_bus_register_handler(app_event_handler,
                                      subscribed_events,
                                      ARRAY_SIZE(subscribed_events));
}

SYS_INIT(register_callback, APPLICATION, CONFIG_APPLICATION_INIT_PRIORITY);

#endif // CONFIG_EVENT_BUS_USE_CALLBACK
```

## src/polling_receiver.c
```c
#include <zephyr/kernel.h>
#include <zephyr/logging/log.h>
#include "event_bus.h"

#if defined(CONFIG_EVENT_BUS_USE_POLLING)

LOG_MODULE_REGISTER(polling_receiver, CONFIG_LOG_DEFAULT_LEVEL);

K_MSGQ_DEFINE(polling_q, sizeof(app_event_t), 4, 4);

static void polling_receiver_thread(void)
{
    LOG_INF("Polling receiver thread started.");
    const event_id_t subscribed_events[] = { EVENT_APP_MESSAGE_SENT };
    event_bus_subscribe(&polling_q, subscribed_events, ARRAY_SIZE(subscribed_events));

    app_event_t received_event;
    while (1) {
        k_msgq_get(&polling_q, &received_event, K_FOREVER);
        LOG_WRN("POLLING receiver got event in thread %s. Payload: %d",
                k_thread_name_get(k_current_get()), received_event.payload.s32);
    }
}

K_THREAD_DEFINE(polling_receiver, 1024, polling_receiver_thread, NULL, NULL, NULL, 7, 0, 0);

#endif // CONFIG_EVENT_BUS_USE_POLLING#include <zephyr/kernel.h>
#include <zephyr/logging/log.h>
#include "event_bus.h"

#if defined(CONFIG_EVENT_BUS_USE_POLLING)

LOG_MODULE_REGISTER(polling_receiver, CONFIG_LOG_DEFAULT_LEVEL);

K_MSGQ_DEFINE(polling_q, sizeof(app_event_t), 4, 4);

static void polling_receiver_thread(void)
{
    LOG_INF("Polling receiver thread started.");
    const event_id_t subscribed_events[] = { EVENT_DOOR_OPENED };
    event_bus_subscribe(&polling_q, subscribed_events, ARRAY_SIZE(subscribed_events));

    app_event_t received_event;
    while (1) {
        k_msgq_get(&polling_q, &received_event, K_FOREVER);
        LOG_WRN("POLLING receiver got event in thread %s. Payload: %d",
                k_thread_name_get(k_current_get()), received_event.payload.s32);
    }
}

K_THREAD_DEFINE(polling_receiver, 1024, polling_receiver_thread, NULL, NULL, NULL, 7, 0, 0);

#endif // CONFIG_EVENT_BUS_USE_POLLING
```

## src/processing_thread.c
```c
#include "processing_thread.h" // <-- Include the new header
#include <zephyr/logging/log.h>

LOG_MODULE_REGISTER(processing, CONFIG_LOG_DEFAULT_LEVEL);

// This is now the global definition of the message queue.
// It matches the 'extern' declaration in the header.
K_MSGQ_DEFINE(processing_msgq, sizeof(app_event_t), 10, 4);

static void processing_thread_entry(void)
{
    LOG_INF("Processing thread started, waiting for messages.");
    app_event_t received_event;

    while (1) {
        // Wait forever for a message to arrive
        k_msgq_get(&processing_msgq, &received_event, K_FOREVER);

        LOG_INF("Processing thread DEQUEUED event %d", received_event.id);

        // --- HEAVY OR BLOCKING PROCESSING HAPPENS HERE ---
        k_msleep(500);

        LOG_INF("Processing thread FINISHED handling event. Payload: %d", received_event.payload.s32);
    }
}

K_THREAD_DEFINE(processing_thread, 1024, processing_thread_entry, NULL, NULL, NULL, 7, 0, 0);
```

## src/processing_thread.h
```c
#pragma once

#include <zephyr/kernel.h>
#include "event_bus.h" // For app_event_t

// Declare the message queue as 'extern' so other files know it exists globally.
extern struct k_msgq processing_msgq;
```

## src/sender.c
```c
#include <zephyr/kernel.h>
#include <zephyr/logging/log.h>
#include "event_bus.h"

LOG_MODULE_REGISTER(sender, CONFIG_LOG_DEFAULT_LEVEL);

static void sender_thread(void)
{
    int counter = 0;
    while (1) {
        k_msleep(3000); // Wait 3 seconds
        const app_event_t msg_event = {
            .id = EVENT_DOOR_OPENED,
            .payload = { .s32 = counter++ }
        };
        LOG_INF("Posting event from thread %s...", k_thread_name_get(k_current_get()));
        event_bus_post(&msg_event);
    }
}

K_THREAD_DEFINE(sender, 1024, sender_thread, NULL, NULL, NULL, 7, 0, 0);
```
