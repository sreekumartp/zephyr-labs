## CMakeLists.txt
```
cmake_minimum_required(VERSION 3.20.0)
find_package(Zephyr REQUIRED HINTS $ENV{ZEPHYR_BASE})
project(test_sim_fsm)

# Add include directory to find fsm.h
zephyr_include_directories(
  ${CMAKE_CURRENT_SOURCE_DIR}/../include
)


target_sources(app PRIVATE
  src/test_fsm.c
  ../src/fsm.c
)
```

## prj.conf
```kconfig
# Configuration for Washing Machine Simulation Application
CONFIG_SHELL=y
CONFIG_SERIAL=y
CONFIG_UART_CONSOLE=y
CONFIG_MAIN_STACK_SIZE=2048

# Optional: Enable history, autocomplete, or extra commands
CONFIG_SHELL_HISTORY=y
CONFIG_SHELL_CMDS=y
CONFIG_DEVICE_SHELL=y

# GPIO support
CONFIG_GPIO=y
CONFIG_GPIO_INIT_PRIORITY=40

# Enable GPIO Emulator for native_sim
CONFIG_GPIO_EMUL=y

# Enable assertions and unit testing
CONFIG_ZTEST=y
CONFIG_ZTEST_ASSERT_VERBOSE=1
```

## src/test_fsm.c
```c
#include "fsm.h"
#include <zephyr/ztest.h>

ZTEST(fsm_suite, test_default_state_is_idle)
{
    zassert_equal(fsm_get_current_state(), FSM_STATE_IDLE, "Should start in IDLE state");
}

ZTEST(fsm_suite, test_state_transition)
{
    fsm_set_state(FSM_STATE_RUNNING);
    zassert_equal(fsm_get_current_state(), FSM_STATE_RUNNING, "Should transition to RUNNING");
}
ZTEST(fsm_suite, test_state_maximum)
{
    zassert_equal(FSM_STATE_MAXIMUM, FSM_STATE_MAX - 1, "FSM_STATE_MAXIMUM should be one less than FSM_STATE_MAX");
}


ZTEST_SUITE(fsm_suite, NULL, NULL, NULL, NULL, NULL);
```

## src/test_wm.c
```c
#include <zephyr/ztest.h>
#include "sim_door_sensor.h"
#include "fsm.h"



ZTEST(wm_test_suite, test_wash_cycle_door_open)
{
    // Simulate door open during wash cycle
    door_sensor_sim_set_state(false);  // Simulate door open
    zassert_false(is_door_closed(), "WM should detect door is open");
}

ZTEST(wm_test_suite, test_wash_cycle_door_closed)
{
    // Simulate door closed during wash cycle
    door_sensor_sim_set_state(true);  // Simulate door closed
    zassert_true(is_door_closed(), "WM should detect door is closed");

}

ZTEST_SUITE(wm_test_suite, NULL, NULL, NULL, NULL, NULL);
```
