## CMakeLists.txt
```
cmake_minimum_required(VERSION 3.20.0)
list(APPEND ZEPHYR_EXTRA_MODULES ${CMAKE_CURRENT_SOURCE_DIR}/../../../../components/event_bus)
find_package(Zephyr REQUIRED HINTS $ENV{ZEPHYR_BASE})

project(sim_door_sensor_test)

# Include the header from the sim_door_sensor implementation
zephyr_include_directories(
  ${CMAKE_CURRENT_SOURCE_DIR}/../include
  ${CMAKE_CURRENT_SOURCE_DIR}/../../../../components/event_bus/include
  ${CMAKE_CURRENT_SOURCE_DIR}/../../../fsm/include
)

# Link test source and implementation source
target_sources(app PRIVATE
  src/test_sim_door_sensor.c
  ../src/sim_door_sensor.c
  # ${CMAKE_CURRENT_SOURCE_DIR}/../../../../components/event_bus/src/event_bus.c
)

# Link the application against the library target.
target_link_libraries(app PRIVATE event_bus_lib)
```

## prj.conf
```kconfig
CONFIG_ZTEST=y

# GPIO support
CONFIG_GPIO=y
CONFIG_GPIO_INIT_PRIORITY=40

# Enable GPIO Emulator for native_sim
CONFIG_GPIO_EMUL=y

CONFIG_TEST=y
CONFIG_LOG=y
CONFIG_LOG_MODE_IMMEDIATE=y
CONFIG_MAIN_STACK_SIZE=2048

CONFIG_ASSERT=y
CONFIG_ASSERT_VERBOSE=n
CONFIG_ASSERT_LEVEL=2
```

## app.overlay
```dts
/*
 * Copyright (c) 2024 Your Name
 * SPDX-License-Identifier: Apache-2.0
 *
 * This overlay is for the sim_door_sensor test environment.
 * It provides the necessary 'sensor0' alias for the component under test.
 */

/ {
    /*
     * We only need to define the sensor alias that our component uses.
     * The test will link it to the gpio0 controller provided by native_sim.
     */
    sensors {
        compatible = "gpio-keys";

        test_sensor_node: test_sensor_0 {
            label = "Test Sensor";
            gpios = <&gpio0 1 GPIO_ACTIVE_HIGH>;
        };
    };


    aliases {
        /*
         * This alias is what the sim_door_sensor.c component looks for.
         * The #error directive will now be satisfied.
         */
        sensor0 = &test_sensor_node;
    };
};
```

## src/test_sim_door_sensor.c
```c
#include <zephyr/ztest.h>
#include "sim_door_sensor.h"

/**
 * @brief A one-time setup function that runs once before the entire suite.
 *
 * This is the correct place for one-time initialization.
 */
static void *suite_setup(void)
{
	int ret;

	/* Initialize the component under test. */
	ret = door_sensor_sim_init();
	zassert_ok(ret, "Failed to initialize door sensor simulation in setup");

	return NULL;
}

/**
 * @brief A function that runs before each individual test case.
 *
 * This is the correct place to reset the state for each test, preventing
 * one test from affecting another.
 */
static void test_before(void *data)
{
	ARG_UNUSED(data);
	int ret;

	/* Set a known starting state before every test. */
	ret = door_sensor_sim_set_state(false); /* Start with door open */
	zassert_ok(ret, "Failed to set initial state in test_before");
}


/**
 * @brief Test case for the door sensor in the 'open' state.
 */
ZTEST(wachine_sim_suite, test_door_sensor_open)
{
	/* The test_before() function ensures the sensor starts in the OPEN state. */
	zassert_false(door_sensor_sim_get_state(), "Sensor should be in OPEN state");
}

/**
 * @brief Test case for the door sensor in the 'closed' state.
 */
ZTEST(wachine_sim_suite, test_door_sensor_closed)
{
	int ret;

	/* Action: Set the sensor state to closed. */
	ret = door_sensor_sim_set_state(true);
	zassert_ok(ret, "Failed to set door sensor state to closed");

	/* Assert: Verify the state is now closed. */
	zassert_true(door_sensor_sim_get_state(), "Sensor should be in CLOSED state");
}


/**
 * @brief Define the test suite, using both suite_setup and test_before.
 *
 * ZTEST_SUITE(name, predicate, suite_setup, test_before, test_after, suite_teardown);
 */
ZTEST_SUITE(wachine_sim_suite, NULL, suite_setup, test_before, NULL, NULL);
```

## src/ztest_sensor_door.c
```c
#include <zephyr/ztest.h>
#include <zephyr/kernel.h>
#include <zephyr/logging/log.h>
#include <zephyr/sys/time_units.h>

#include "event_bus.h"
#include "event_defs.h"

LOG_MODULE_REGISTER(test_sensor_door, LOG_LEVEL_INF);

extern int sensor_door_start(void);
extern event_id_t sensor_door_get_state(void);
static struct {
    app_event_t event;
    int count;
    int64_t timestamps[10];
} door_event_log;

static struct k_sem event_sem;

static void test_event_handler(const app_event_t *event) {
    LOG_INF("test_event_handler received event id: %d", event->id);

    if (event->id == EVENT_DOOR_OPENED || event->id == EVENT_DOOR_CLOSED) {
        if (door_event_log.count < 10) {
            door_event_log.timestamps[door_event_log.count] = k_uptime_get();
        }
        door_event_log.event = *event;
        door_event_log.count++;
        k_sem_give(&event_sem);
    }
}

static void *setup_fn(void)
{
    LOG_INF("Initializing event bus and test environment");
    event_bus_init();
    k_sem_init(&event_sem, 0, 10);
    door_event_log.count = 0;
    event_bus_register_handler(test_event_handler);
    sensor_door_start();
    return NULL;
}

ZTEST(sensor_door_tests, test_door_event_published_on_state_change)
{
    event_id_t door_open = EVENT_DOOR_OPENED;
    app_event_t inject = { .id = EVENT_UNKNOWN };
    memcpy(&inject.id, &door_open, sizeof(door_open));
    LOG_INF("Publishing EVENT_DOOR_OPENED with door_open: %d", door_open);
    event_bus_publish(&inject);
    k_sleep(K_SECONDS(1));
    event_id_t retrieved_state=sensor_door_get_state();
    LOG_INF("Retrieved door state: %d", retrieved_state);

    zassert_equal(retrieved_state, EVENT_DOOR_OPENED, "Expected door state to be OPENED");

}


ZTEST(sensor_door_tests, test_door_event_published_on_state_change_closed   )
{
    event_id_t door_state = EVENT_DOOR_CLOSED;
    app_event_t inject = { .id = EVENT_UNKNOWN };
    memcpy(&inject.id, &door_state, sizeof(door_state));
    LOG_INF("Publishing EVENT_DOOR_CLOSED with door_open: %d", door_state);
    event_bus_publish(&inject);
    k_sleep(K_SECONDS(1));
    event_id_t retrieved_state=sensor_door_get_state();
    LOG_INF("Retrieved door state: %d", retrieved_state);

    zassert_equal(retrieved_state, EVENT_DOOR_CLOSED, "Expected door state to be door_state CLOSED");


}


//simulates a faulty door sensor that toggles between open and closed states
// this is to test the robustness of the door sensor handling logic
// it should not cause the system to crash or behave unexpectedly
ZTEST(sensor_door_tests, test_door_event_toggles)
{
    
    event_id_t door_state = EVENT_DOOR_CLOSED;
    app_event_t evt = { .id = EVENT_UNKNOWN};


    for(int i=0; i < 3; i++) {
  
        door_state = EVENT_DOOR_OPENED;
        memcpy(&evt.id, &door_state, sizeof(door_state));
        LOG_INF("Publishing EVENT_TEST_DOOR_INPUT with door_closed: %d", door_state);
        event_bus_publish(&evt);
        
        k_sleep(K_MSEC(10));
        door_state = EVENT_DOOR_CLOSED;
        memcpy(&evt.id, &door_state, sizeof(door_state));
        LOG_INF("Publishing EVENT_TEST_DOOR_INPUT with door_open: %d", door_state);
        event_bus_publish(&evt);
        k_sleep(K_MSEC(10));

    }
    event_id_t retrieved_state=sensor_door_get_state();
    LOG_INF("Retrieved door state: %d", retrieved_state);

    zassert_equal(retrieved_state, EVENT_DOOR_CLOSED, "Expected door state to be door_state CLOSED");
}


ZTEST_SUITE(sensor_door_tests, NULL, setup_fn, NULL, NULL, NULL);
```
