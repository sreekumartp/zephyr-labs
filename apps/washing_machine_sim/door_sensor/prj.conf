## CMakeLists.txt
```
cmake_minimum_required(VERSION 3.20.0)
find_package(Zephyr REQUIRED HINTS $ENV{ZEPHYR_BASE})
project(door_sensor)


# Add your application's source files to the 'app' target
target_sources(app PRIVATE src/door_sensor.c)
target_include_directories(app PRIVATE
    include
    ../sim_door_sensor/include
    ${CMAKE_CURRENT_SOURCE_DIR}/../../../components/event_bus/include
)

# zephyr_library_named(door_sensor)
# zephyr_library_sources(
#     src/door_sensor.c
# )
# zephyr_include_directories(
#     include
#     ../sim_door_sensor/include
# )
```

## prj.conf
```kconfig
# Enable serial driver support
CONFIG_SERIAL=y

# Use UART as the shell console
CONFIG_UART_CONSOLE=y


CONFIG_LOG=y
# Process log messages immediately. Crucial for debugging real-time issues.
CONFIG_LOG_MODE_IMMEDIATE=y
# Set the default log level for all modules to INFO.
# You can override this for specific modules if needed.
CONFIG_LOG_DEFAULT_LEVEL=3
# Increase the size of the message queue for logging.
# CONFIG_LOG_MSG_QUEUE_SIZE=1024
```

## include/door_sensor.h
```c
#pragma once

#ifdef __cplusplus
extern "C" {
#endif

/**
 * @brief Initialize the door sensor wrapper.
 *
 * This function starts the background polling for the simulated door sensor.
 * It will post an EVENT_DOOR_STATE_CHANGED event on state changes.
 */
void door_sensor_init(void);

#ifdef __cplusplus
}
#endif
```

## src/door_sensor.c
```c
#include <zephyr/kernel.h>
#include <zephyr/sys/printk.h>
#include <zephyr/sys/util.h>
#include <zephyr/sys/__assert.h>
#include <zephyr/logging/log.h>
#include "sim_door_sensor.h"
#include "event_bus.h"
#include "event_defs.h"
#include "door_sensor.h"

LOG_MODULE_REGISTER(door_sensor, LOG_LEVEL_INF);
#define DOOR_SENSOR_POLL_INTERVAL_MS 100

static bool last_state;

static void door_sensor_poll_thread(void *arg1, void *arg2, void *arg3)
{
    ARG_UNUSED(arg1);
    ARG_UNUSED(arg2);
    ARG_UNUSED(arg3);
    event_id_t evt;

    while (1) {
        bool current = door_sensor_sim_get_state();
        if (current != last_state) {
            last_state = current;
            if (current == 0)
            {
                evt = EVENT_DOOR_OPENED;
            }
            else
            {
                evt = EVENT_DOOR_CLOSED;
            }
            app_event_t event = {
                .id = evt,
                .sender_tid = k_current_get(),
                .payload.u32 = k_uptime_get_32()
            };

            LOG_INF("door_sensor_poll_thread posting event ID: %d", evt);

            event_bus_post(&event);
        }
        k_msleep(DOOR_SENSOR_POLL_INTERVAL_MS);
    }
}

K_THREAD_STACK_DEFINE(door_sensor_stack, 512);
static struct k_thread door_sensor_thread;

void door_sensor_init(void)
{
    bool rval=false;
    int ret;
    ret=door_sensor_sim_init();
     __ASSERT(rval == false, "Failed initializing door sensor simulation");   
    rval=door_sensor_sim_set_state(false);
    __ASSERT(rval == false, "Failed to set initial door sensor state");
    last_state = door_sensor_sim_get_state();
    k_thread_create(&door_sensor_thread, door_sensor_stack, K_THREAD_STACK_SIZEOF(door_sensor_stack),
                    door_sensor_poll_thread, NULL, NULL, NULL,
                    5, 0, K_NO_WAIT);
}
```
