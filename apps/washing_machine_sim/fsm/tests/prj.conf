## CMakeLists.txt
```
# CMakeLists.txt for the L1 FSM test application

# Standard Zephyr project setup
cmake_minimum_required(VERSION 3.22)
find_package(Zephyr REQUIRED HINTS $ENV{ZEPHYR_BASE})
project(l1_fsm_test)

# The test requires the parent FSM include directory to find the header files
# (fsm.h, l1_system_fsm.h, etc.).
target_include_directories(app PRIVATE
    ${CMAKE_CURRENT_SOURCE_DIR}/../../../../components/event_bus/include
    ../include
    ../src

    )

# Add the source files to be compiled for this test application.
# This includes the Ztest source file itself and the L1 FSM implementation
# which is the code being tested.
target_sources(app PRIVATE
    src/test_l1_system_fsm.c
    ../src/l1_system_fsm.c
    src/test_l2_wash_cycle_fsm.c
    ../src/l2_wash_cycle_fsm.c
       src/test_fsm_dispatcher.c
    ../src/fsm.c    
    )
```

## prj.conf
```kconfig
# Enable the ZTest framework
CONFIG_ZTEST=y

# Enable logging to see output from the FSM module
CONFIG_LOG=y

# Set the log level for the FSM module to Debug to get detailed output during tests
#CONFIG_FSM_LOG_LEVEL_DBG=y
```

## src/test_fsm_dispatcher.c
```c
#include <zephyr/ztest.h>
#include "fsm.h"
#include "l1_system_fsm.h"
#include "l2_wash_cycle_fsm.h"

// Test fixture
static fsm_handle_t fsm;

// This function runs before each test case
static void fsm_dispatcher_before(void *data)
{
    ARG_UNUSED(data);
    // Use the real FSM init function to set the FSM to its starting state.
    fsm_init(&fsm);
}

// --- Test Cases ---

ZTEST(fsm_dispatcher_suite, test_initial_state)
{
    zassert_equal(fsm.system_state, STATE_L1_POWER_OFF, "Initial L1 state should be POWER_OFF");
    zassert_equal(fsm.wash_cycle_state, STATE_L2_IDLE, "Initial L2 state should be IDLE");
}

ZTEST(fsm_dispatcher_suite, test_l1_event_dispatch)
{
    // This event should be handled by the L1 FSM
    fsm_process_event(&fsm, EVENT_POWER_BUTTON_PRESSED);
    zassert_equal(fsm.system_state, STATE_L1_STANDBY, "Dispatcher failed to send event to L1 FSM");
}

ZTEST(fsm_dispatcher_suite, test_l2_event_dispatch_when_running)
{
    // Manually set the state to RUNNING to test L2 dispatch
    fsm.system_state = STATE_L1_RUNNING;
    fsm.wash_cycle_state = STATE_L2_WASHING; // A state that can receive an event

    // This event should be dispatched to the L2 FSM
    fsm_process_event(&fsm, EVENT_TIMER_EXPIRED);

    // Check if the L2 state changed as expected
    zassert_equal(fsm.wash_cycle_state, STATE_L2_DRAINING_WASH, "Dispatcher failed to send event to L2 FSM");
    // Ensure L1 state did not change
    zassert_equal(fsm.system_state, STATE_L1_RUNNING, "L1 state should not change on L2 event");
}

ZTEST(fsm_dispatcher_suite, test_l1_override_event_dispatch_when_running)
{
    // Manually set the state to RUNNING
    fsm.system_state = STATE_L1_RUNNING;
    fsm.wash_cycle_state = STATE_L2_WASHING;

    // This is a high-priority event that L1 should handle even when RUNNING
    fsm_process_event(&fsm, EVENT_PAUSE_BUTTON_PRESSED);

    // Check that the L1 FSM handled the override correctly
    zassert_equal(fsm.system_state, STATE_L1_PAUSED, "Dispatcher failed to prioritize L1 override event");
    // L2 state should remain unchanged
    zassert_equal(fsm.wash_cycle_state, STATE_L2_WASHING, "L2 state should not change on L1 override");
}

ZTEST(fsm_dispatcher_suite, test_l2_completion_event_promotion_to_l1)
{
    // Set up the conditions for the test:
    // L1 is RUNNING, L2 is in its final state before COMPLETE
    fsm.system_state = STATE_L1_RUNNING;
    fsm.wash_cycle_state = STATE_L2_STEAMING; // A state that transitions to COMPLETE
    fsm.program_has_steam = true;

    // This event will cause the L2 FSM to transition to STATE_L2_COMPLETE
    fsm_process_event(&fsm, EVENT_TIMER_EXPIRED);

    // The dispatcher should detect this L2 completion and automatically
    // send the EVENT_CYCLE_FINISHED to the L1 FSM.
    zassert_equal(fsm.wash_cycle_state, STATE_L2_COMPLETE, "L2 cycle should be complete");
    zassert_equal(fsm.system_state, STATE_L1_END, "L1 should transition to END after L2 completes");
}


// --- Test Suite Definition ---
ZTEST_SUITE(fsm_dispatcher_suite, NULL, NULL, fsm_dispatcher_before, NULL, NULL);
```

## src/test_l1_system_fsm.c
```c
#include <zephyr/ztest.h>
#include "fsm.h"
#include "l1_system_fsm.h"
#include "l2_wash_cycle_fsm.h"

// --- Test Fixture ---
// A single FSM handle to be used by all tests in this suite.
static fsm_handle_t fsm;

// --- Mock Implementations for L2 FSM Dependencies ---
// These are mock functions that satisfy the linker for this unit test.
// They allow us to test the L1 FSM in complete isolation from the L2 FSM.
// We use weak aliases so that if this test is ever linked with the real
// l2_wash_cycle_fsm.c, the real functions will be used instead.

__weak void l2_fsm_init(fsm_handle_t *fsm_handle)
{
    // In this test, we just need to verify that l2_fsm_init resets the state.
    if (fsm_handle) {
        fsm_handle->wash_cycle_state = STATE_L2_IDLE;
    }
}

__weak void l2_fsm_start(fsm_handle_t *fsm_handle)
{
    // The L1 FSM calls this to start the wash cycle. For this test,
    // we just need to mock the transition to the first L2 state.
    if (fsm_handle) {
        fsm_handle->wash_cycle_state = STATE_L2_LOAD_SENSING;
    }
}

// This mock is not strictly required for L1 testing, but included for completeness
// if any test path were to accidentally call it.
__weak void l2_wash_cycle_process_event(fsm_handle_t *fsm, event_id_t event)
{
    // Do nothing in the L1 tests.
}


// --- ZTest Setup ---
// This function runs before each test case, ensuring a clean slate.
static void l1_fsm_before(void *data)
{
    ARG_UNUSED(data);
    // Use the real L1 init function to set the FSM to its starting state.
    l1_fsm_init(&fsm);
}

// --- Test Cases ---

ZTEST(l1_fsm_suite, test_initial_state)
{
    zassert_equal(fsm.system_state, STATE_L1_POWER_OFF, "Initial state should be POWER_OFF");
}

ZTEST(l1_fsm_suite, test_power_cycle)
{
    // Power On
    l1_system_process_event(&fsm, EVENT_POWER_BUTTON_PRESSED);
    zassert_equal(fsm.system_state, STATE_L1_STANDBY, "Failed to transition from POWER_OFF to STANDBY");

    // Power Off from Standby
    l1_system_process_event(&fsm, EVENT_POWER_BUTTON_PRESSED);
    zassert_equal(fsm.system_state, STATE_L1_POWER_OFF, "Failed to transition from STANDBY to POWER_OFF");
}

ZTEST(l1_fsm_suite, test_program_selection_and_start)
{
    // Go to Standby first
    fsm.system_state = STATE_L1_STANDBY;

    l1_system_process_event(&fsm, EVENT_CYCLE_SELECTED);
    zassert_equal(fsm.system_state, STATE_L1_SELECTION, "Failed to transition from STANDBY to SELECTION");

    l1_system_process_event(&fsm, EVENT_START_BUTTON_PRESSED);
    zassert_equal(fsm.system_state, STATE_L1_RUNNING, "Failed to transition from SELECTION to RUNNING");
    // Verify that the L2 FSM was started by our mock function
    zassert_equal(fsm.wash_cycle_state, STATE_L2_LOAD_SENSING, "L2 FSM was not started correctly");
}

ZTEST(l1_fsm_suite, test_running_state_overrides)
{
    // Start in the RUNNING state
    fsm.system_state = STATE_L1_RUNNING;
    bool handled;

    // Test Pause override
    handled = l1_system_process_override_events(&fsm, EVENT_PAUSE_BUTTON_PRESSED);
    zassert_true(handled, "PAUSE event should be handled by override");
    zassert_equal(fsm.system_state, STATE_L1_PAUSED, "Failed to transition from RUNNING to PAUSED");

    // Test Brownout override
    fsm.system_state = STATE_L1_RUNNING; // Reset for next test
    handled = l1_system_process_override_events(&fsm, EVENT_POWER_LOSS_DETECTED);
    zassert_true(handled, "POWER_LOSS event should be handled by override");
    zassert_equal(fsm.system_state, STATE_L1_BROWNOUT, "Failed to transition from RUNNING to BROWNOUT");

    // Test Failure override
    fsm.system_state = STATE_L1_RUNNING; // Reset for next test
    handled = l1_system_process_override_events(&fsm, EVENT_FATAL_FAULT_DETECTED);
    zassert_true(handled, "FATAL_FAULT event should be handled by override");
    zassert_equal(fsm.system_state, STATE_L1_FAILURE, "Failed to transition from RUNNING to FAILURE");
}

ZTEST(l1_fsm_suite, test_running_to_end_transition)
{
    fsm.system_state = STATE_L1_RUNNING;
    // This event is not an override, so it's processed by the main handler
    l1_system_process_event(&fsm, EVENT_CYCLE_FINISHED);
    zassert_equal(fsm.system_state, STATE_L1_END, "Failed to transition from RUNNING to END");
}

ZTEST(l1_fsm_suite, test_paused_state_transitions)
{
    // Start in PAUSED state
    fsm.system_state = STATE_L1_PAUSED;

    // Test Resume
    l1_system_process_event(&fsm, EVENT_START_BUTTON_PRESSED);
    zassert_equal(fsm.system_state, STATE_L1_RUNNING, "Failed to resume from PAUSED to RUNNING");

    // Test Cancel
    fsm.system_state = STATE_L1_PAUSED; // Reset
    fsm.wash_cycle_state = STATE_L2_WASHING; // Pretend L2 was running
    l1_system_process_event(&fsm, EVENT_CANCEL_BUTTON_PRESSED);
    zassert_equal(fsm.system_state, STATE_L1_SELECTION, "Failed to cancel from PAUSED to SELECTION");
    // Verify that the L2 FSM was reset by our mock function
    zassert_equal(fsm.wash_cycle_state, STATE_L2_IDLE, "L2 FSM was not reset on cancel");
}

ZTEST(l1_fsm_suite, test_recovery_state_transitions)
{
    // Test End state recovery
    fsm.system_state = STATE_L1_END;
    l1_system_process_event(&fsm, EVENT_ANY_KEY_PRESSED);
    zassert_equal(fsm.system_state, STATE_L1_SELECTION, "Failed to transition from END to SELECTION");

    // Test Brownout recovery
    fsm.system_state = STATE_L1_BROWNOUT;
    l1_system_process_event(&fsm, EVENT_POWER_RESTORED);
    zassert_equal(fsm.system_state, STATE_L1_RUNNING, "Failed to recover from BROWNOUT to RUNNING");

    // Test Failure recovery
    fsm.system_state = STATE_L1_FAILURE;
    l1_system_process_event(&fsm, EVENT_POWER_BUTTON_PRESSED);
    zassert_equal(fsm.system_state, STATE_L1_STANDBY, "Failed to recover from FAILURE to STANDBY");
}


// --- Test Suite Definition ---
ZTEST_SUITE(l1_fsm_suite, NULL, NULL, l1_fsm_before, NULL, NULL);
```

## src/test_l2_wash_cycle_fsm.c
```c
#include <zephyr/ztest.h>
#include "fsm.h"
#include "l2_wash_cycle_fsm.h"

// --- Test Fixture ---
// A single FSM handle to be used by all tests in this suite.
static fsm_handle_t fsm;

// --- ZTest Setup ---
// This function runs before each test case, ensuring a clean slate.
static void l2_fsm_before(void *data)
{
    ARG_UNUSED(data);
    // Use the real L2 init function to set the FSM to its starting state.
    l2_fsm_init(&fsm);
    // Also reset program parameters for each test
    fsm.program_has_prewash = false;
    fsm.program_has_heating = false;
    fsm.program_has_steam = false;
}

// --- Test Cases ---

ZTEST(l2_fsm_suite, test_initial_state)
{
    zassert_equal(fsm.wash_cycle_state, STATE_L2_IDLE, "Initial state should be IDLE");
}

ZTEST(l2_fsm_suite, test_start_cycle)
{
    l2_fsm_start(&fsm);
    zassert_equal(fsm.wash_cycle_state, STATE_L2_LOAD_SENSING, "l2_fsm_start should transition to LOAD_SENSING");
}

ZTEST(l2_fsm_suite, test_full_cycle_path_no_options)
{
    // This test verifies the "happy path" when no optional cycles are enabled.

    // Start in the first active state
    fsm.wash_cycle_state = STATE_L2_LOAD_SENSING;
    zassert_equal(fsm.wash_cycle_state, STATE_L2_LOAD_SENSING, "Should start in Load Sensing");

    l2_wash_cycle_process_event(&fsm, EVENT_WEIGHT_CALCULATED);
    zassert_equal(fsm.wash_cycle_state, STATE_L2_DOSING, "Failed transition to Dosing");

    l2_wash_cycle_process_event(&fsm, EVENT_DOSING_COMPLETE);
    zassert_equal(fsm.wash_cycle_state, STATE_L2_PREWASH_CHECK, "Failed transition to Prewash Check");

    // Process the check state (which is synchronous and should immediately transition)
    l2_wash_cycle_process_event(&fsm, 0); // Event doesn't matter for check states
    zassert_equal(fsm.wash_cycle_state, STATE_L2_FILLING, "Should have skipped Prewash");

    l2_wash_cycle_process_event(&fsm, EVENT_WATER_LEVEL_REACHED);
    zassert_equal(fsm.wash_cycle_state, STATE_L2_HEATING_CHECK, "Failed transition to Heating Check");

    l2_wash_cycle_process_event(&fsm, 0);
    zassert_equal(fsm.wash_cycle_state, STATE_L2_WASHING, "Should have skipped Heating");

    l2_wash_cycle_process_event(&fsm, EVENT_TIMER_EXPIRED);
    zassert_equal(fsm.wash_cycle_state, STATE_L2_DRAINING_WASH, "Failed transition to Draining Wash");

    l2_wash_cycle_process_event(&fsm, EVENT_DRUM_EMPTY);
    zassert_equal(fsm.wash_cycle_state, STATE_L2_RINSING, "Failed transition to Rinsing");

    l2_wash_cycle_process_event(&fsm, EVENT_TIMER_EXPIRED);
    zassert_equal(fsm.wash_cycle_state, STATE_L2_DRAINING_RINSE, "Failed transition to Draining Rinse");

    l2_wash_cycle_process_event(&fsm, EVENT_DRUM_EMPTY);
    zassert_equal(fsm.wash_cycle_state, STATE_L2_SPINNING, "Failed transition to Spinning");

    l2_wash_cycle_process_event(&fsm, EVENT_TIMER_EXPIRED);
    zassert_equal(fsm.wash_cycle_state, STATE_L2_STEAM_CHECK, "Failed transition to Steam Check");

    l2_wash_cycle_process_event(&fsm, EVENT_UNKNOWN); // No steam, so this should skip
    zassert_equal(fsm.wash_cycle_state, STATE_L2_COMPLETE, "Should have skipped Steam");
}

ZTEST(l2_fsm_suite, test_prewash_path_is_taken)
{
    // Set the condition for this path
    fsm.program_has_prewash = true;
    fsm.wash_cycle_state = STATE_L2_PREWASH_CHECK;

    l2_wash_cycle_process_event(&fsm, EVENT_DOSING_COMPLETE);
    zassert_equal(fsm.wash_cycle_state, STATE_L2_PREWASH, "Did not enter Prewash state when required");
}

ZTEST(l2_fsm_suite, test_heating_path_is_taken)
{
    // Set the condition for this path
    fsm.program_has_heating = true;
    fsm.wash_cycle_state = STATE_L2_HEATING_CHECK;

    l2_wash_cycle_process_event(&fsm, EVENT_TEMP_REACHED);
    zassert_equal(fsm.wash_cycle_state, STATE_L2_HEATING, "Did not enter Heating state when required");
}

ZTEST(l2_fsm_suite, test_steam_path_is_taken)
{
    // Set the condition for this path
    fsm.program_has_steam = true;
    fsm.wash_cycle_state = STATE_L2_STEAM_CHECK;

    l2_wash_cycle_process_event(&fsm, EVENT_STEAM_READY);
    zassert_equal(fsm.wash_cycle_state, STATE_L2_STEAMING, "Did not enter Steaming state when required");
}


// --- Test Suite Definition ---
ZTEST_SUITE(l2_fsm_suite, NULL, NULL, l2_fsm_before, NULL, NULL);
```

## src/ztest_multithreaded.c
```c
#include <zephyr/ztest.h>
#include <zephyr/kernel.h>
#include <zephyr/logging/log.h>

#include "event_bus.h"
#include "event_defs.h"
#include "fsm.h"
#include "controller_thread.h"

LOG_MODULE_REGISTER(test_multithreaded, LOG_LEVEL_INF);

ZTEST(multithreaded_tests, test_start_button_event_triggers_fsm)
{
    event_t event = { .type = EVENT_START_BUTTON_PRESSED };
    int ret = event_bus_post(&event);
    zassert_equal(ret, 0, "Failed to publish EVENT_START_BUTTON_PRESSED");

    k_sleep(K_MSEC(100));

    fsm_handle_t *fsm = controller_fsm_get_handle();
    zassert_equal(fsm->system_state, STATE_L1_RUNNING, "Expected L1 state: RUNNING");
    zassert_equal(fsm->wash_cycle_state, STATE_L2_FILLING, "Expected L2 state: FILLING");
}

ZTEST_SUITE(multithreaded_tests, NULL, NULL, NULL, NULL, NULL);
```
