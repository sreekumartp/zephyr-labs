## apps/washing_machine_sim/fsm/tests/testcase.yaml
```yaml
tests:
  fsm.l1.system:
    tags: 
      - fsm
      - l1
    # This test is pure logic and can run on the fast native_posix target
    platform_allow: native_sim
    integration_platforms:
      - native_sim
```

## apps/washing_machine_sim/sim_door_sensor/test/testcase.yaml
```yaml
tests:
  wachine.sim.suite:
    build_on_all: true
    platform_allow:
      - native_sim
    tags: simulator
```

## apps/washing_machine_sim/sim_water_level/test/testcase.yaml
```yaml
tests:
  wachine_sim.waterlevel.low:
    build_on_all: true
    platform_allow:
      - native_sim
    tags: simulator
```

## apps/washing_machine_sim/test/testcase.yaml
```yaml
tests:
  washing_machine_sim.wm.transitions:
    tags: wm
    platform_allow: [native_sim]
    build_on_all: true
```

## components/event_bus/src/Kconfig
```kconfig
# Kconfig for the Event Bus component

choice EVENT_BUS_SUBSCRIBER_TYPE
    prompt "Event Bus Subscriber Mechanism"
    default EVENT_BUS_USE_CALLBACK
    help
      Select the subscriber mechanism for the event bus. This choice
      is mutually exclusive.

    config EVENT_BUS_USE_POLLING
        bool "Polling (Message Queue) based subscribers"
        help
          This option enables a dispatcher thread that forwards events
          to subscriber-specific message queues. Each subscriber must
          have its own thread to poll its queue.

    config EVENT_BUS_USE_CALLBACK
        bool "Callback (Work Queue) based subscribers"
        help
          This option enables a system where callbacks are registered
          and executed from a dedicated worker thread pool (work queue).
          This is generally more memory efficient as subscribers do not
          need their own dedicated threads.

endchoice
```

## components/event_bus/tests/testcase.yaml
```yaml
tests:
  libraries.event_bus.polling:
    tags: event_bus
    # This test scenario enables the polling configuration
    extra_configs:
      - CONFIG_EVENT_BUS_USE_POLLING=y
    platform_allow: native_sim

  libraries.event_bus.callback:
    tags: event_bus
    # This test scenario enables the callback configuration
    extra_configs:
      - CONFIG_EVENT_BUS_USE_CALLBACK=y
      - CONFIG_SYSTEM_WORKQUEUE_STACK_SIZE=2048
    platform_allow: native_sim
```

## west.yml
```yaml
manifest:
  defaults:
    remote: zephyrproject  # 👈 Default remote used for projects below

  remotes:
    - name: zephyrproject  # 👈 Alias for GitHub Zephyr org
      url-base: https://github.com/zephyrproject-rtos

  projects:
    # 👇 Zephyr RTOS source code
    - name: zephyr
      repo-path: zephyr
      revision: main  # 👈 You can pin to a tag or SHA (e.g., v3.5.0)
      import:
        path-prefix: modules  # 👈 Automatically pulls Zephyr's own modules

    # (Optional) Example of a shared external component
    # - name: device-utils
    #   repo-path: modules/device-utils
    #   revision: main
    #   remote: your-org

  self:
    path: .  # 👈 This monorepo is the "main application"
```
